/**
  * @file    oled.c
  * @brief   Text-only driver for a 128x64 SSD1315/SSD1306 OLED on STM32F042 (HAL, I2C).
  */
#include "oled.h"
#include <stdarg.h>
#include <stdio.h>

#define CTRL_CMD    0x00U   /* I2C control byte: following bytes are commands   */
#define CTRL_DATA   0x40U   /* I2C control byte: following bytes are display RAM */
#define CELL_W      6U      /* 5 px glyph + 1 px gap */
#define FONT_FIRST  32
#define FONT_LAST   126

/* ==========================================================================
 * Bus layer. Everything hardware specific is in this block.
 * ========================================================================== */
#if !OLED_PORT_CUSTOM

#include "custom_bus.h"   /* hi2c1, shared with the VL53L4CD driver; init via BSP_I2C1_Init() */

void OLED_PortDelayMs(uint32_t ms)
{
  HAL_Delay(ms);
}

int32_t OLED_PortWrite(uint8_t ctrl, const uint8_t *data, uint16_t len)
{
  /* The control byte goes in the "memory address" slot, so this sends exactly
     START, addr+W, ctrl, data[0..len-1], STOP. HAL handles NACK, stale TXDR and timeouts. */
  if (HAL_I2C_Mem_Write(&OLED_I2C_HANDLE, (uint16_t)(OLED_I2C_ADDR << 1), ctrl,
                        I2C_MEMADD_SIZE_8BIT, (uint8_t *)data, len,
                        OLED_I2C_TIMEOUT_MS) != HAL_OK)
  {
    return -1;
  }
  return 0;
}

#endif /* !OLED_PORT_CUSTOM */

/* 5x7 font, one byte per column, LSB = top pixel. ASCII 32..126, lives in flash. */
static const uint8_t font5x7[FONT_LAST - FONT_FIRST + 1][5] = {
  {0x00,0x00,0x00,0x00,0x00}, /* ' ' */ {0x00,0x00,0x5F,0x00,0x00}, /* ! */
  {0x00,0x07,0x00,0x07,0x00}, /* " */   {0x14,0x7F,0x14,0x7F,0x14}, /* # */
  {0x24,0x2A,0x7F,0x2A,0x12}, /* $ */   {0x23,0x13,0x08,0x64,0x62}, /* % */
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  {0x10,0x08,0x08,0x10,0x08}, /* ~ */
};

static const uint8_t zeros[128];   /* all zero, in flash */

/* Initialisation sequence (SSD1315 / SSD1306 compatible), sent as one command stream. */
static const uint8_t init_seq[] = {
  0xAE,                 /* display off */
  0xD5, 0x80,           /* clock divide / oscillator */
  0xA8, 0x3F,           /* multiplex ratio: 64 rows */
  0xD3, 0x00,           /* display offset */
  0x40,                 /* start line 0 */
  0x8D, 0x14,           /* charge pump on */
  0x20, 0x02,           /* page addressing mode */
#if OLED_ROTATE_180
  0xA0, 0xC0,
#else
  0xA1, 0xC8,           /* segment remap + COM scan direction */
#endif
  0xDA, 0x12,           /* COM pins */
  0x81, 0xCF,           /* contrast */
  0xD9, 0xF1,           /* pre-charge */
  0xDB, 0x40,           /* VCOMH */
  0xA4,                 /* follow RAM content */
  0xA6,                 /* normal (not inverted) */
};

/* ---- Low level ------------------------------------------------------------ */

static int32_t i2c_write(uint8_t ctrl, const uint8_t *data, uint16_t len)
{
  return OLED_PortWrite(ctrl, data, len);
}

static void cmd(uint8_t c)
{
  (void)i2c_write(CTRL_CMD, &c, 1);
}

static void set_pos(uint8_t page, uint8_t x)
{
  uint8_t c[3];

  c[0] = (uint8_t)(0xB0U | (page & 0x07U));
  c[1] = (uint8_t)(x & 0x0FU);
  c[2] = (uint8_t)(0x10U | (x >> 4));
  (void)i2c_write(CTRL_CMD, c, 3);
}

static const uint8_t *glyph(char ch)
{
  if ((ch < FONT_FIRST) || (ch > FONT_LAST))
  {
    ch = '?';
  }
  return font5x7[ch - FONT_FIRST];
}

/* Spread the 4 low bits of n so that every bit becomes two bits (vertical 2x). */
static uint8_t stretch4(uint8_t n)
{
  uint8_t r = 0;
  uint8_t i;

  for (i = 0; i < 4U; i++)
  {
    if (n & (1U << i))
    {
      r |= (uint8_t)(3U << (2U * i));
    }
  }
  return r;
}

/* ---- Public API ----------------------------------------------------------- */

int32_t OLED_Init(void)
{
  OLED_PortDelayMs(100);   /* let the panel power up */
  if (i2c_write(CTRL_CMD, init_seq, sizeof(init_seq)) != 0)
  {
    return -1;           /* no ACK from the display or bus error */
  }
  OLED_Clear();
  cmd(0xAF);        /* display on */
  return 0;
}

void OLED_ClearRow(uint8_t row)
{
  if (row < OLED_ROWS)
  {
    set_pos(row, 0);
    (void)i2c_write(CTRL_DATA, zeros, 128);
  }
}

void OLED_Clear(void)
{
  uint8_t row;
  for (row = 0; row < OLED_ROWS; row++)
  {
    OLED_ClearRow(row);
  }
}

void OLED_SetContrast(uint8_t contrast)
{
  uint8_t c[2] = { 0x81, contrast };
  (void)i2c_write(CTRL_CMD, c, 2);
}

void OLED_Power(uint8_t on)
{
  cmd(on ? 0xAF : 0xAE);
}

void OLED_Print(uint8_t col, uint8_t row, const char *str)
{
  uint8_t buf[CELL_W];
  uint8_t i;

  if ((str == NULL) || (row >= OLED_ROWS) || (col >= OLED_COLS))
  {
    return;
  }
  set_pos(row, (uint8_t)(col * CELL_W));
  for (; (*str != '\0') && (col < OLED_COLS); str++, col++)
  {
    const uint8_t *g = glyph(*str);
    for (i = 0; i < 5U; i++)
    {
      buf[i] = g[i];
    }
    buf[5] = 0;
    (void)i2c_write(CTRL_DATA, buf, CELL_W);
  }
}

void OLED_Print2x(uint8_t col, uint8_t row, const char *str)
{
  uint8_t buf[2U * CELL_W];
  uint8_t half, c, i;
  const char *p;

  if ((str == NULL) || (row > (OLED_ROWS - 2U)))
  {
    return;
  }
  for (half = 0; half < 2U; half++)      /* top page, then bottom page */
  {
    if (col >= OLED_COLS)
    {
      return;
    }
    set_pos((uint8_t)(row + half), (uint8_t)(col * CELL_W));
    for (p = str, c = col; (*p != '\0') && ((c + 2U) <= OLED_COLS); p++, c += 2U)
    {
      const uint8_t *g = glyph(*p);
      for (i = 0; i < 6U; i++)
      {
        uint8_t v = (i < 5U) ? g[i] : 0U;
        v = stretch4(half ? (uint8_t)(v >> 4) : (uint8_t)(v & 0x0FU));
        buf[2U * i]      = v;
        buf[2U * i + 1U] = v;
      }
      (void)i2c_write(CTRL_DATA, buf, sizeof(buf));
    }
  }
}

void OLED_Printf(uint8_t col, uint8_t row, const char *fmt, ...)
{
  char buf[OLED_COLS + 1];
  va_list ap;

  va_start(ap, fmt);
  (void)vsnprintf(buf, sizeof(buf), fmt, ap);
  va_end(ap);
  OLED_Print(col, row, buf);
}

void OLED_Printf2x(uint8_t col, uint8_t row, const char *fmt, ...)
{
  char buf[OLED_COLS + 1];
  va_list ap;

  va_start(ap, fmt);
  (void)vsnprintf(buf, sizeof(buf), fmt, ap);
  va_end(ap);
  OLED_Print2x(col, row, buf);
}
